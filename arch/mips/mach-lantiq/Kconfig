## arch/mips/mach-lantiq/Kconfig
```kconfig
if ARCH_LANTIQ

config SYS_SOC
	default "lantiq"

config TARGET_P2812HNUF1_RAM
	bool "Zyxel P-2812HNU-F1 ROM UART RAM prototype"
	select LANTIQ_ASC_SERIAL
	select DISPLAY_BOARDINFO
	select BOARD_EARLY_INIT_R

source "board/zyxel/p2812hnuf1/Kconfig"

endif
```

## board/zyxel/p2812hnuf1/Kconfig
```kconfig
if TARGET_P2812HNUF1_RAM

config SYS_BOARD
	default "p2812hnuf1"

config SYS_VENDOR
	default "zyxel"

config SYS_CONFIG_NAME
	default "p2812hnuf1_ram"

config CMD_P2812_NANDKLOAD
	bool "Bounded P2812 NAND kernel read/verify command"
	depends on NAND_LANTIQ_RO && CMD_BOOTM
	help
	  Fixed partition and RAM address, ECC and CRC checked.
	  No decompression, Linux execution or persistent modification.

config CMD_P2812_NANDBOOTCHECK
	bool "P2812 interruptible read-only autoboot rehearsal"
	depends on CMD_P2812_NANDKLOAD && LMB
	help
	  Default bootcmd may read, verify and decompress the kernel, then
	  invalidate bootm state and return to the console. Never runs Linux.
	  In this profile bootm decompression errors return instead of reset.

config CMD_P2812_LINUXRUN
	bool "P2812 manual fixed NAND/RAM Linux handoff"
	depends on CMD_P2812_NANDKLOAD && LMB && BOOTM_LINUX
	help
	  Verify the fixed input and run bootm through Linux PREP and GO.
	  Retain the output reservation through handoff; clean up on failure.
	  Does not enable NAND programming or persistent environment writes.

endif
```

## configs/p2812hnuf1_nandfinal1_defconfig
```kconfig
CONFIG_MIPS=y
CONFIG_ARCH_LANTIQ=y
CONFIG_TARGET_P2812HNUF1_RAM=y
CONFIG_CPU_MIPS32_R2=y
CONFIG_MIPS_CACHE_DISABLE=y
CONFIG_MIPS_CACHE_SETUP=y
CONFIG_TEXT_BASE=0xa0100000
CONFIG_SYS_LOAD_ADDR=0xa2000000
CONFIG_SYS_MALLOC_LEN=0x200000
CONFIG_SYS_MALLOC_F_LEN=0x4000
CONFIG_ENV_SIZE=0x2000
CONFIG_ENV_IS_NOWHERE=y
CONFIG_DEFAULT_DEVICE_TREE="lantiq-p2812hnu-f1-ram"
# CONFIG_OF_SEPARATE is not set
CONFIG_OF_EMBED=y
CONFIG_LOCALVERSION="-p2812-nandfinal1"
# CONFIG_LOCALVERSION_AUTO is not set
CONFIG_IDENT_STRING=" P2812HNU-F1 NAND Linux autoboot candidate MDIO1 GPHY1"
CONFIG_SYS_PROMPT="P2812-2026-NANDFINAL1> "
CONFIG_HUSH_PARSER=y
CONFIG_CMD_BDI=y
CONFIG_CMD_CONSOLE=y
CONFIG_CMD_DM=y
CONFIG_CMD_CONFIG=y
CONFIG_AUTOBOOT=y
CONFIG_BOOTDELAY=5
CONFIG_USE_BOOTCOMMAND=y
CONFIG_BOOTCOMMAND="nandbootrun"
CONFIG_CMD_BOOTM=y
CONFIG_BOOTM_LINUX=y
CONFIG_SYS_BOOTM_LEN=0x1000000
CONFIG_LZMA=y
CONFIG_SYS_MALLOC_BOOTPARAMS=y
CONFIG_SYS_BOOTPARAMS_LEN=0x20000
CONFIG_MIPS_BOOT_CMDLINE_LEGACY=y
CONFIG_MIPS_BOOT_ENV_LEGACY=y
# CONFIG_MIPS_BOOT_FDT is not set
# CONFIG_CMD_BOOTD is not set
# CONFIG_CMD_BOOTEFI is not set
# CONFIG_CMD_ELF is not set
# CONFIG_CMD_FDT is not set
CONFIG_CMD_IMI=y
# CONFIG_CMD_XIMG is not set
# CONFIG_CMD_GO is not set
# CONFIG_CMD_RUN is not set
# CONFIG_CMD_SOURCE is not set
# CONFIG_CMD_SETEXPR is not set
# CONFIG_CMD_CRC32 is not set
# CONFIG_CMD_EXPORTENV is not set
# CONFIG_CMD_IMPORTENV is not set
# CONFIG_CMD_EDITENV is not set
# CONFIG_CMD_MEMORY is not set
CONFIG_CMD_LOADB=y
# CONFIG_CMD_LOADS is not set
# CONFIG_CMD_SAVEENV is not set
# CONFIG_CMD_ERASEENV is not set
# CONFIG_CMD_FLASH is not set
# CONFIG_CMD_NAND is not set
# CONFIG_CMD_MTD is not set
# CONFIG_CMD_SF is not set
# CONFIG_CMD_NET is not set
# CONFIG_NET is not set
CONFIG_MTD=y
CONFIG_MTD_RAW_NAND=y
CONFIG_NAND_LANTIQ_RO=y
# CONFIG_SYS_NAND_USE_FLASH_BBT is not set
# CONFIG_SYS_NAND_ONFI_DETECTION is not set
# CONFIG_MMC is not set
# CONFIG_USB is not set
# CONFIG_EFI_LOADER is not set
# CONFIG_BOOTSTD is not set
# CONFIG_FS_FAT is not set
# CONFIG_FS_EXT4 is not set
# CONFIG_WATCHDOG is not set
# CONFIG_WDT is not set
CONFIG_LANTIQ_ASC_SERIAL=y
CONFIG_DEBUG_UART=y
CONFIG_DEBUG_UART_LANTIQ_ASC=y
CONFIG_DEBUG_UART_BASE=0xbe100c00
CONFIG_DEBUG_UART_CLOCK=125000000
CONFIG_DEBUG_UART_ANNOUNCE=y
CONFIG_BAUDRATE=115200
CONFIG_CMD_P2812_NANDKLOAD=y
# CONFIG_CMD_P2812_NANDBOOTCHECK is not set
CONFIG_CMD_P2812_LINUXRUN=y
```
